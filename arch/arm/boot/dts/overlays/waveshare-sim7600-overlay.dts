/dts-v1/;
/plugin/;

/ {
    compatible = "brcm,bcm2708,bcm2710,bcm2711";

    fragment@0 {
        target = <&gpio>;
        __overlay__ {
            pinctrl-names = "default";
            pinctrl-0 = <&modem_pins>;

            modem_pins: modem_pins {
                brcm,pins = <4 6>;     /* GPIO pins */
                brcm,function = <1 1>; /* Output */
                brcm,pull = <2 2>; /* pull high */
            };
        };
    };
};
